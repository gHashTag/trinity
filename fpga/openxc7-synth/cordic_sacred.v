//! Strand III: Language \& Hardware Bridge
//!
//! FPGA component for Trinity S³AI — synthesizable Verilog module.
//!

// ============================================================================
// SACRED CORDIC — Continued Fraction Optimized Rotation Pipeline
// ============================================================================
//
// Bridge: CORDIC iterations ≈ Continued Fraction convergents
//
// For φ²/π² = 0.161552..., CF = [0; 6, 4, 1, 8, ...]
// Convergent 113/426 means 6 CORDIC stages give ~16-bit accuracy
//
// Optimization: Hybrid CORDIC
// - Small partial quotients (1,2,3): standard CORDIC iteration
// - Large partial quotients (>4): ROM lookup (one cycle)
//
// Generated by TRI sacred-const cordic-sacred
//
// ============================================================================

`default_nettype none

module cordic_cf_pipeline #(
    parameter WIDTH = 25,
    parameter STAGES = 12
)(
    input  wire clk,
    input  wire rst,
    input  wire en,
    input  wire [WIDTH-1:0] x_in,
    input  wire [WIDTH-1:0] y_in,
    input  wire signed [WIDTH-1:0] z_in,
    output wire [WIDTH-1:0] x_out,
    output wire [WIDTH-1:0] y_out,
    output wire signed [WIDTH-1:0] z_out,
    output wire valid_out
);

    // Pipeline wires between stages
    wire [WIDTH-1:0] x_pipe [0:STAGES];
    wire [WIDTH-1:0] y_pipe [0:STAGES];
    wire signed [WIDTH-1:0] z_pipe [0:STAGES];

    // First stage inputs
    assign x_pipe[0] = x_in;
    assign y_pipe[0] = y_in;
    assign z_pipe[0] = z_in;

    // Generate CORDIC stages
    genvar i;
    generate
        for (i = 0; i < STAGES; i = i + 1) begin : gen_cordic_stage
            cordic_iter_stage #(
                .STAGE(i),
                .WIDTH(WIDTH)
            ) stage (
                .clk(clk),
                .rst(rst),
                .en(en),
                .x_in(x_pipe[i]),
                .y_in(y_pipe[i]),
                .z_in(z_pipe[i]),
                .x_out(x_pipe[i+1]),
                .y_out(y_pipe[i+1]),
                .z_out(z_pipe[i+1]),
                .d()
            );
        end
    endgenerate

    assign x_out = x_pipe[STAGES];
    assign y_out = y_pipe[STAGES];
    assign z_out = z_pipe[STAGES];

    // Valid signal (pipeline delay)
    reg [$clog2(STAGES+1)-1:0] valid_shift;
    always @(posedge clk) begin
        if (rst) valid_shift <= 0;
        else if (en) begin
            valid_shift <= (valid_shift << 1) | 1'b1;
        end
    end
    assign valid_out = valid_shift[$clog2(STAGES)];

endmodule

// CORDIC iteration stage
module cordic_iter_stage #(
    parameter STAGE = 0,
    parameter WIDTH = 25
)(
    input  wire clk,
    input  wire rst,
    input  wire en,
    input  wire [WIDTH-1:0] x_in,
    input  wire [WIDTH-1:0] y_in,
    input  wire signed [WIDTH-1:0] z_in,
    output wire [WIDTH-1:0] x_out,
    output wire [WIDTH-1:0] y_out,
    output wire signed [WIDTH-1:0] z_out,
    output wire d
);

    wire d_wire = z_in[WIDTH-1];
    reg d_reg;
    always @(posedge clk) begin
        if (rst) d_reg <= 1'b0;
        else if (en) d_reg <= d_wire;
    end
    assign d = d_reg;

    localparam SHIFT = STAGE;
    reg [WIDTH-1:0] x_reg, y_reg;
    reg signed [WIDTH-1:0] z_reg;

    always @(posedge clk) begin
        if (rst) begin
            x_reg <= 0;
            y_reg <= 0;
            z_reg <= 0;
        end else if (en) begin
            x_reg <= x_in - (d_reg ? (y_in >>> SHIFT) : 0);
            y_reg <= y_in + (d_reg ? (x_in >>> SHIFT) : 0);
            z_reg <= z_in - (d_reg ? get_arctan(STAGE) : 0);
        end
    end

    assign x_out = x_reg;
    assign y_out = y_reg;
    assign z_out = z_reg;

    // Arctan lookup function
    function [WIDTH-1:0] get_arctan;
        input [3:0] stage;
        begin
            case (stage)
                0:  get_arctan = 25'd421657;  // arctan(1) = 45°
                1:  get_arctan = 25'd249615;  // arctan(0.5)
                2:  get_arctan = 25'd131769;  // arctan(0.25)
                3:  get_arctan = 25'd66616;   // arctan(0.125)
                4:  get_arctan = 25'd33424;   // arctan(0.0625)
                5:  get_arctan = 25'd16729;   // arctan(0.03125)
                default: get_arctan = 25'd0;
            endcase
        end
    endfunction

endmodule

`default_nettype wire
// SPDX-License-Identifier: Apache-2.0
// vcd-wrapped-counter-tb.v -- testbench for the ClockedCounter sample of the vcd-wrapped widget.
//
// The device is module ClockedCounter, generated by public/t27/t27_compiler.wasm (verilog target)
// from specs/ternary/clocked_counter.t27; scripts/widget-data/vcd-wrapped.mjs writes it beside this
// file in the work directory and runs iverilog, then vvp. This file is hand-written stimulus: it is
// not generated from the spec. It checks the spec's own test (count is 0, then 1, then 2 after two
// clocks), then that en low holds count, that the u8 count wraps from 255 to 0, and that rst_n low
// clears it at once. Each check prints one line: CHECK <name> pass|fail <count> <expected>.
`timescale 1ns / 1ps
`default_nettype none

module tb;
    reg clk = 1'b0;
    reg rst_n = 1'b0;
    reg en = 1'b0;
    wire ready;
    wire [7:0] count;
    integer errors = 0;
    integer k;

    ClockedCounter dut (.clk(clk), .rst_n(rst_n), .en(en), .ready(ready), .count(count));

    always #5 clk = ~clk;

    task check(input [8*24-1:0] name, input [7:0] expected);
        begin
            if (count === expected) $display("CHECK %0s pass %0d %0d", name, count, expected);
            else begin
                $display("CHECK %0s fail %0d %0d", name, count, expected);
                errors = errors + 1;
            end
        end
    endtask

    initial begin
        $dumpfile("waves.vcd");
        $dumpvars(0, tb);
        // reset held for two clocks, released between edges
        repeat (2) @(posedge clk);
        #2 rst_n = 1'b1;
        check("spec_count_starts_at_0", 8'd0);
        en = 1'b1;
        @(posedge clk); #1 check("spec_one_clock_is_1", 8'd1);
        @(posedge clk); #1 check("spec_two_clocks_is_2", 8'd2);
        // en low: the register holds for eight clocks
        en = 1'b0;
        repeat (8) @(posedge clk);
        #1 check("en_low_holds_count", 8'd2);
        // run past 255: a u8 wraps to 0
        en = 1'b1;
        for (k = 0; k < 253; k = k + 1) @(posedge clk);
        #1 check("count_reaches_255", 8'd255);
        @(posedge clk); #1 check("u8_wraps_to_0", 8'd0);
        repeat (20) @(posedge clk);
        // rst_n low clears at once, without a clock edge
        #2 rst_n = 1'b0;
        #1 check("reset_clears_count", 8'd0);
        #10 rst_n = 1'b1;
        repeat (4) @(posedge clk);
        en = 1'b0;
        repeat (2) @(posedge clk);
        $display("DONE errors=%0d", errors);
        $finish;
    end
endmodule

`default_nettype wire
